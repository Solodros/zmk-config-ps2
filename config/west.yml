## config/west.yml
```yaml
manifest:
  remotes:
    - name: zmkfirmware
      url-base: https://github.com/zmkfirmware
    - name: urob
      url-base: https://github.com/urob
    - name: infused-kim
      url-base: https://github.com/infused-kim
    - name: Solodros
      url-base: https://github.com/Solodros
  projects:
    - name: zmk
      remote: Solodros
      revision: PS2
      import: app/west.yml
  self:
    path: config
```
